#include "hal_data.h"

#include "example_AES.h"
#include "app_definitions.h"

FSP_CPP_HEADER
void R_BSP_WarmStart(bsp_warm_start_event_t event);
FSP_CPP_FOOTER

bool result = false;

/*******************************************************************************************************************//**
 * main() is generated by the RA Configuration editor and is used to generate threads if an RTOS is used.  This function
 * is called by main() when no RTOS is used.
 **********************************************************************************************************************/
void hal_entry(void)
{
    APP_PRINT(BANNER_1);
    APP_PRINT(APPLICATION_NAME);
    APP_PRINT(BANNER_2);

    /*initialize the lfs */
    result = init_lfs();

    if(true == result)
    {
        APP_PRINT(LFS_INITIALIZATION_SUCCESS);
    }
    else
    {
        APP_PRINT(LFS_INITIALIZATION_FAILED);
    }

    /* call the secure service to perform the following operations:
     * 1. inject the NIST plaintext AES key
     * 2. perform encryption operation with the injected key
     * 3. perform decryption operation with the injected key
     *
     */
    result =  psacrypto_AES256CBC_example_NIST (  );

    if (true == result)
    {
        APP_PRINT(AES_KEY_CREATION_SUCCESSFUL);
        APP_PRINT(ENCRYPTION_SUCCESSFUL);
        APP_PRINT(DECRYPTION_SUCCESSFUL);
    }
    else
    {
        APP_PRINT(EXAMPLE_AES_OPERATION_FAILED);
    }


   while(true)
   {
       ;
   }

#if BSP_TZ_SECURE_BUILD
    /* Enter non-secure code */
    R_BSP_NonSecureEnter();
#endif
}

/*******************************************************************************************************************//**
 * This function is called at various points during the startup process.  This implementation uses the event that is
 * called right before main() to set up the pins.
 *
 * @param[in]  event    Where at in the start up process the code is currently at
 **********************************************************************************************************************/
void R_BSP_WarmStart(bsp_warm_start_event_t event)
{
    if (BSP_WARM_START_RESET == event)
    {
#if BSP_FEATURE_FLASH_LP_VERSION != 0

        /* Enable reading from data flash. */
        R_FACI_LP->DFLCTL = 1U;

        /* Would normally have to wait tDSTOP(6us) for data flash recovery. Placing the enable here, before clock and
         * C runtime initialization, should negate the need for a delay since the initialization will typically take more than 6us. */
#endif
    }

    if (BSP_WARM_START_POST_C == event)
    {
        /* C runtime environment and system clocks are setup. */

        /* Configure pins. */
        IOPORT_CFG_OPEN (&IOPORT_CFG_CTRL, &IOPORT_CFG_NAME);
    }
}

#if BSP_TZ_SECURE_BUILD

FSP_CPP_HEADER
BSP_CMSE_NONSECURE_ENTRY void template_nonsecure_callable ();

/* Trustzone Secure Projects require at least one nonsecure callable function in order to build (Remove this if it is not required to build). */
BSP_CMSE_NONSECURE_ENTRY void template_nonsecure_callable ()
{

}
FSP_CPP_FOOTER

#endif
