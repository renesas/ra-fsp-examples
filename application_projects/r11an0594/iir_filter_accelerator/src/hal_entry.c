#include "hal_data.h"
#include "common_utils.h"

#define NUM_STAGES    (8)               /* Number of IIRFA biquad stages, half of the filter order */
#define NUM_PERIODS   (16)              /* Number of periods to process in the filter */
#define RES           (256)             /* Samples per period of input sinusoid */
#define LENGTH        (RES*NUM_PERIODS) /* Length of input and output signals */

/* Sets a breakpoint and notify users once signal processing is complete */
#define APP_COMPLETION_TRAP {\
SEGGER_RTT_printf(SEGGER_INDEX, "\r\nFilter processing is complete. Output signal is ready to be exported for visualization.\r\n");\
__asm("BKPT #0\n");}

/* Variable specifies the chunk size of data to pass to the function R_IIRFA_Filter() */
static const uint16_t  NUM_SAMP = 256;

/* Input signal noise is a 256 samples/period sinusoid @ 100 Hz with added random noise */
static const float noise[] = {
1151,3855,-4477,1965,902,-2379,-538,1100,7776,6168,-2219,6809,2127,559,2199,363,574,3925,3805,3867,2384,-1421,2563,4475,2179,3338,2747,
676,1938,-238,3230,-903,-708,-141,-4480,4527,2279,97,4480,-1804,1519,1261,2434,2445,56,1788,1533,3176,4149,4198,175,2117,-514,-295,1982,
5146,440,2785,1570,4325,-190,2111,3177,4301,5208,2220,-1014,516,-143,6838,756,3540,1602,3805,406,-913,-970,2926,1546,1489,4777,2447,2233,
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-3700,-3038,-2571,-2051,-1623,-896,-7080,-1766,1760,-2922,1222,74,-655,-174,-3704,-623,2884,-150,-217,-1755,-265,324,772,-815,-486
};

/* Output signal */
volatile float output[LENGTH] = {0};

/* Variables to support the filter processing */
static volatile int cnt = 0;
static volatile int cnt_period = 0;
static volatile bool processing = 1;
static volatile bool filter_err = 0;

volatile fsp_err_t err = FSP_SUCCESS;

/* Biquad state data (clear to start) */
iir_filter_state_t gp_iirfa0_filter_state[NUM_STAGES] = {0};

const iir_filter_coeffs_t gp_iirfa0_filter_coeffs[NUM_STAGES] =
{
     /* Insert coefficients from 'IIRFA_coeffs.txt' generated from the 'extract_coefficients.m' MATLAB script below this line. */

};

/* Filter configuration */
iir_filter_cfg_t g_iirfa0_filter_cfg =
{
    .p_filter_coeffs = gp_iirfa0_filter_coeffs, // Pointer to filter coefficient array
    .p_filter_state  = gp_iirfa0_filter_state,  // Pointer to filter state data array
    .stage_base      = 0,                       // Which hardware biquad stage to start allocation from (0-31)
    .stage_num       = NUM_STAGES,                       // Number of stages to allocate
};


FSP_CPP_HEADER
void R_BSP_WarmStart(bsp_warm_start_event_t event);
FSP_CPP_FOOTER

/*******************************************************************************************************************//**
 * main() is generated by the RA Configuration editor and is used to generate threads if an RTOS is used.  This function
 * is called by main() when no RTOS is used.
 **********************************************************************************************************************/
void hal_entry(void)
{

    /* Initialize the IIRFA */
    err = R_IIRFA_Open(&g_iirfa0_ctrl, &g_iirfa0_cfg);

    /* Handle error */
    if (FSP_SUCCESS != err)
    {   /* IIRFA module open failed */
        APP_ERR_PRINT("\r\n ** IIRFA Open API failed ** \r\n");
        APP_ERR_TRAP(err);
    }

    /* Configure filter with coefficients and state variables */
    err = R_IIRFA_Configure(&g_iirfa0_ctrl, &g_iirfa0_filter_cfg);

    /* Handle error */
    if (FSP_SUCCESS != err)
    {   /* IIRFA module configure failed */
        APP_ERR_PRINT("\r\n ** IIRFA Configure API failed ** \r\n");
        APP_ERR_TRAP(err);
    }

    /* Initialize the AGT timer and start it */
    err = R_AGT_Open(&g_timer0_ctrl, &g_timer0_cfg);
    /* Handle error */
    if (FSP_SUCCESS != err)
    {   /* AGT module open failed */
        APP_ERR_PRINT("\r\n ** AGT Open API failed ** \r\n");
        APP_ERR_TRAP(err);
    }

    err = R_AGT_Start(&g_timer0_ctrl);
    /* Handle error */
    if (FSP_SUCCESS != err)
    {   /* AGT module start failed */
        APP_ERR_PRINT("\r\n ** AGT Start API failed ** \r\n");
        APP_ERR_TRAP(err);
    }

    /* Code will loop until filter has processed all periods specified by NUM_PERIODS */
    while(processing){
        /* Handle error */
        if(filter_err)
        {   /* IIR module filter failed */
            APP_ERR_PRINT("\r\n ** IIRFA Filter API failed ** \r\n");
            APP_ERR_TRAP(err);
        }

    }

    /* Once this breakpoint is reached the output signal is ready to be exported */
    APP_COMPLETION_TRAP;

#if BSP_TZ_SECURE_BUILD
    /* Enter non-secure code */
    R_BSP_NonSecureEnter();
#endif
}

/*******************************************************************************************************************//**
 * This function is called at various points during the startup process.  This implementation uses the event that is
 * called right before main() to set up the pins.
 *
 * @param[in]  event    Where at in the start up process the code is currently at
 **********************************************************************************************************************/
void R_BSP_WarmStart(bsp_warm_start_event_t event)
{
    if (BSP_WARM_START_RESET == event)
    {
#if BSP_FEATURE_FLASH_LP_VERSION != 0

        /* Enable reading from data flash. */
        R_FACI_LP->DFLCTL = 1U;

        /* Would normally have to wait tDSTOP(6us) for data flash recovery. Placing the enable here, before clock and
         * C runtime initialization, should negate the need for a delay since the initialization will typically take more than 6us. */
#endif
    }

    if (BSP_WARM_START_POST_C == event)
    {
        /* C runtime environment and system clocks are setup. */

        /* Configure pins. */
        R_IOPORT_Open (&g_ioport_ctrl, g_ioport.p_cfg);
    }
}

#if BSP_TZ_SECURE_BUILD

BSP_CMSE_NONSECURE_ENTRY void template_nonsecure_callable ();

/* Trustzone Secure Projects require at least one nonsecure callable function in order to build (Remove this if it is not required to build). */
BSP_CMSE_NONSECURE_ENTRY void template_nonsecure_callable ()
{

}
#endif

/* AGT callback function which will trigger at 25600Hz */
void agt_callback(timer_callback_args_t *p_args){

    /* Filter 1 period of the sinusoid with the R_IIRFA_Filter function */
    err = R_IIRFA_Filter(&g_iirfa0_ctrl, &noise[0], &output[cnt], NUM_SAMP);

    /* Handle error */
    if (FSP_SUCCESS != err)
    {   /* IIRFA module filter failed */
        filter_err = 1;
    }

    /* Increment the period and sample count */
    cnt += NUM_SAMP;
    ++cnt_period;

    /* Stop the timer after all samples have been processed */
    if(cnt_period >= NUM_PERIODS)
    {
        processing = 0;
        err = R_AGT_Stop(&g_timer0_ctrl);
    }

    return;
}

