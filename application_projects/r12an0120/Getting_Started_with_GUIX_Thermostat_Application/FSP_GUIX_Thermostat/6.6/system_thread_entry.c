#include "system_thread.h"
#include "system_api.h"
#include "brightness.h"
#include "system_time.h"
#include "temperature_time_thread.h"
#include "guix_gen/thermostat_resources.h"
#include "guix_gen/thermostat_specifications.h"

/* Root Window and screen pointers */
GX_WINDOW*      p_splash_screen;
GX_WINDOW*      p_settings_screen;
GX_WINDOW*      p_thermostat_screen;
GX_WINDOW*      p_mainpage_screen;
GX_WINDOW*      p_help_screen;
GX_WINDOW_ROOT* p_root;

/***********************************************************************************************************************
 Private functions
 ***********************************************************************************************************************/
static void send_hmi_message(gx_event_message_t event);
static fsp_err_t gpt_timer_PWM_setup(void);
static fsp_err_t ADC_Setup(void);


/** Stored GUI state. */
extern system_state_t g_gui_state;

/* System Thread entry function */
void system_thread_entry(void)
{
    fsp_err_t     err            = FSP_SUCCESS;
    UINT          status         = TX_SUCCESS;
    UINT          gx_err         = GX_SUCCESS;
    uint16_t      adc_temp_data  = 0;

    /* Initialize time-keeping hardware (RTC). */
    system_time_init();

    /* Initializes GUIX. */
    gx_err = gx_system_initialize();
    if(TX_SUCCESS != gx_err)
    {
        APP_ERR_TRAP(FSP_ERR_ASSERTION);
    }

    /* Configure main display */
    gx_err = gx_studio_display_configure(DISPLAY,
                                rm_guix_port_hw_initialize,
                                LANGUAGE_ENGLISH,
                                DISPLAY_THEME_1,
                                &p_root);
    if(GX_SUCCESS != gx_err)
    {
        APP_ERR_TRAP(FSP_ERR_ASSERTION);
    }

    /* Set pointer to the first buffer generated by the configuration (rm_guix_port_canvas) */
    gx_err = gx_canvas_memory_define(p_root->gx_window_root_canvas,
                            rm_guix_port_canvas,
                            p_root->gx_window_root_canvas->gx_canvas_memory_size);
    if(GX_SUCCESS != gx_err)
    {
        APP_ERR_TRAP(FSP_ERR_ASSERTION);
    }

    /* Create a screen and attached  it to root window.*/
    gx_err = gx_studio_named_widget_create("Splash", (GX_WIDGET *) p_root, (GX_WIDGET **) &p_splash_screen);
    if(GX_SUCCESS != gx_err)
    {
        APP_ERR_TRAP(FSP_ERR_ASSERTION);
    }

    gx_err = gx_studio_named_widget_create ("Settings", GX_NULL, (GX_WIDGET **) &p_settings_screen);
    if(GX_SUCCESS != gx_err)
    {
        APP_ERR_TRAP(FSP_ERR_ASSERTION);
    }
    gx_err = gx_studio_named_widget_create ("MainPage", GX_NULL, (GX_WIDGET **) &p_mainpage_screen);
    if(GX_SUCCESS != gx_err)
    {
        APP_ERR_TRAP(FSP_ERR_ASSERTION);
    }

    gx_err = gx_studio_named_widget_create ("Thermostat", GX_NULL, (GX_WIDGET **) &p_thermostat_screen);
    if(GX_SUCCESS != gx_err)
    {
        APP_ERR_TRAP(FSP_ERR_ASSERTION);
    }

    gx_err = gx_studio_named_widget_create ("Help", GX_NULL, (GX_WIDGET **) &p_help_screen);
    if(GX_SUCCESS != gx_err)
    {
        APP_ERR_TRAP(FSP_ERR_ASSERTION);
    }
    /* Shows the root window. */
    gx_err = gx_widget_show(p_root);
    if(GX_SUCCESS != gx_err)
    {
        APP_ERR_TRAP(FSP_ERR_ASSERTION);
    }

    /* Start GUIX */
    gx_err = gx_system_start();
    if(GX_SUCCESS != gx_err)
    {
        APP_ERR_TRAP(FSP_ERR_ASSERTION);
    }

    /* Set up GPT/PWM timer using for LCD back light control */
    err = gpt_timer_PWM_setup();

    if(FSP_SUCCESS != err)
    {
        APP_ERR_TRAP(FSP_ERR_ASSERTION);
    }

    /* Set up ADC module */
    err = ADC_Setup();
    if(FSP_SUCCESS != err)
    {
        APP_ERR_TRAP(FSP_ERR_ASSERTION);
    }

    while (1)
    {
        /* Wait for RTC interrupt. */
        status = tx_semaphore_get(&g_timer_semaphore, TX_WAIT_FOREVER);
        if(TX_SUCCESS != status)
        {
            APP_ERR_TRAP(FSP_ERR_ASSERTION);
        }
        /* Get date, time */
        R_RTC_CalendarTimeGet(&g_rtc_ctrl, &g_gui_state.time);
        /* Send GUIX event to update time */
        send_hmi_message(GXEVENT_MSG_TIME_UPDATE);;

        /* Delay and update temperature*/
        tx_thread_sleep (10);
        /* Read die temperature */
        err = R_ADC_Read(&g_adc_ctrl, ADC_CHANNEL_TEMPERATURE, &adc_temp_data);
        /* Handle error */
        if (FSP_SUCCESS != err)
        {
            APP_ERR_TRAP(err);
        }

        /* Conversion of ADC temperature in celsius */
        g_gui_state.temp_c = ADCTEMP_AS_C(adc_temp_data);

        /* Send GUIX event to update time */
        send_hmi_message(GXEVENT_MSG_UPDATE_TEMPERATURE);
        tx_thread_sleep (1);
    }
}

/*******************************************************************************************************************//**
 * @brief This function is setting up GPT/PWM timer
 * @param[in] None
 * @retval    fsp_err_t
 **********************************************************************************************************************/
static fsp_err_t gpt_timer_PWM_setup(void)
{
    fsp_err_t err = FSP_SUCCESS;
    /* Open GPT */
    err = R_GPT_Open(&g_timer_PWM_ctrl, &g_timer_PWM_cfg);
    if(FSP_SUCCESS != err)
    {
        return err;
    }
    /* Enable GPT Timer */
    err = R_GPT_Enable(&g_timer_PWM_ctrl);
    /* Handle error */
    if (FSP_SUCCESS != err)
    {
        return err;
    }
    /* Start GPT timer */
    err = R_GPT_Start(&g_timer_PWM_ctrl);;
    if(FSP_SUCCESS != err)
    {
        return err;
    }

    /* Set brightness (LCD backlight) level: 50 = (45+5) */
    g_gui_state.brightness = 45;
    brightness_up(&g_gui_state.brightness);

    return err;
}

/*******************************************************************************************************************//**
 * @brief This function is setting up ADC
 * @param[in] None
 * @retval    fsp_err_t
 **********************************************************************************************************************/
static fsp_err_t ADC_Setup(void)
{
    fsp_err_t fsp_err = FSP_SUCCESS;

    fsp_err = R_ADC_Open(&g_adc_ctrl, &g_adc_cfg);
    if(FSP_SUCCESS != fsp_err)
    {
        return fsp_err;
    }

    fsp_err = R_ADC_ScanCfg(&g_adc_ctrl, &g_adc_channel_cfg);
    if(FSP_SUCCESS != fsp_err)
    {
        return fsp_err;
    }

    fsp_err = R_ADC_ScanStart(&g_adc_ctrl);
    if(FSP_SUCCESS != fsp_err)
    {
        return fsp_err;
    }

    return fsp_err;
}

/*******************************************************************************************************************//**
 * @brief This function sends event to GUIX
 * @param[in] gx_event_message_t
 * @retval    none
 **********************************************************************************************************************/
static void send_hmi_message(gx_event_message_t event)
{
    UINT gx_err                    = GX_SUCCESS;
    system_payload_t message_to_gx = {0};

    /** Create message. */
    message_to_gx.gx_event.gx_event_type = event;
    message_to_gx.state = g_gui_state;
    message_to_gx.gx_event.gx_event_target = GX_NULL;
    message_to_gx.gx_event.gx_event_payload.gx_event_ulongdata = (ULONG) &message_to_gx;

    /** Post message. */
    gx_err = gx_system_event_send (&message_to_gx.gx_event);
    if (GX_SUCCESS != gx_err)
    {
        APP_ERR_TRAP(FSP_ERR_ASSERTION);
    }
}
