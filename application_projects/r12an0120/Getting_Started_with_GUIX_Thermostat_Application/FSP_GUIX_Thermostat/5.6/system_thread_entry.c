#include "system_thread.h"
#include "system_api.h"
#include "brightness.h"
#include "guix_gen/thermostat_resources.h"
#include "guix_gen/thermostat_specifications.h"

/* Root Window and screen pointers */
GX_WINDOW*      p_splash_screen;
GX_WINDOW*      p_settings_screen;
GX_WINDOW*      p_thermostat_screen;
GX_WINDOW*      p_mainpage_screen;
GX_WINDOW*      p_help_screen;
GX_WINDOW_ROOT* p_root;

/***********************************************************************************************************************
 Private functions
 ***********************************************************************************************************************/
static fsp_err_t gpt_timer_PWM_setup(void);

/** Stored GUI state. */
extern system_state_t g_gui_state;

/* System Thread entry function */
void system_thread_entry(void)
{
    fsp_err_t     err            = FSP_SUCCESS;
    UINT          gx_err         = GX_SUCCESS;


    /* Initializes GUIX. */
    gx_err = gx_system_initialize();
    if(TX_SUCCESS != gx_err)
    {
        APP_ERR_TRAP(FSP_ERR_ASSERTION);
    }

    /* Configure main display */
    gx_err = gx_studio_display_configure(DISPLAY,
                                rm_guix_port_hw_initialize,
                                LANGUAGE_ENGLISH,
                                DISPLAY_THEME_1,
                                &p_root);
    if(GX_SUCCESS != gx_err)
    {
        APP_ERR_TRAP(FSP_ERR_ASSERTION);
    }

    /* Set pointer to the first buffer generated by the configuration (rm_guix_port_canvas) */
    gx_err = gx_canvas_memory_define(p_root->gx_window_root_canvas,
                            rm_guix_port_canvas,
                            p_root->gx_window_root_canvas->gx_canvas_memory_size);
    if(GX_SUCCESS != gx_err)
    {
        APP_ERR_TRAP(FSP_ERR_ASSERTION);
    }

    /* Create a screen and attached  it to root window.*/
    gx_err = gx_studio_named_widget_create("Splash", (GX_WIDGET *) p_root, (GX_WIDGET **) &p_splash_screen);
    if(GX_SUCCESS != gx_err)
    {
        APP_ERR_TRAP(FSP_ERR_ASSERTION);
    }

    gx_err = gx_studio_named_widget_create ("Settings", GX_NULL, (GX_WIDGET **) &p_settings_screen);
    if(GX_SUCCESS != gx_err)
    {
        APP_ERR_TRAP(FSP_ERR_ASSERTION);
    }
    gx_err = gx_studio_named_widget_create ("MainPage", GX_NULL, (GX_WIDGET **) &p_mainpage_screen);
    if(GX_SUCCESS != gx_err)
    {
        APP_ERR_TRAP(FSP_ERR_ASSERTION);
    }

    gx_err = gx_studio_named_widget_create ("Thermostat", GX_NULL, (GX_WIDGET **) &p_thermostat_screen);
    if(GX_SUCCESS != gx_err)
    {
        APP_ERR_TRAP(FSP_ERR_ASSERTION);
    }

    gx_err = gx_studio_named_widget_create ("Help", GX_NULL, (GX_WIDGET **) &p_help_screen);
    if(GX_SUCCESS != gx_err)
    {
        APP_ERR_TRAP(FSP_ERR_ASSERTION);
    }
    /* Shows the root window. */
    gx_err = gx_widget_show(p_root);
    if(GX_SUCCESS != gx_err)
    {
        APP_ERR_TRAP(FSP_ERR_ASSERTION);
    }

    /* Start GUIX */
    gx_err = gx_system_start();
    if(GX_SUCCESS != gx_err)
    {
        APP_ERR_TRAP(FSP_ERR_ASSERTION);
    }

    /* Set up GPT/PWM timer using for LCD back light control */
    err = gpt_timer_PWM_setup();

    if(FSP_SUCCESS != err)
    {
        APP_ERR_TRAP(FSP_ERR_ASSERTION);
    }

    while (1)
    {
        tx_thread_sleep (1);
    }
}

/*******************************************************************************************************************//**
 * @brief This function is setting up GPT/PWM timer
 * @param[in] None
 * @retval    fsp_err_t
 **********************************************************************************************************************/
static fsp_err_t gpt_timer_PWM_setup(void)
{
    fsp_err_t err = FSP_SUCCESS;
    /* Open GPT */
    err = R_GPT_Open(&g_timer_PWM_ctrl, &g_timer_PWM_cfg);
    if(FSP_SUCCESS != err)
    {
        return err;
    }
    /* Enable GPT Timer */
    err = R_GPT_Enable(&g_timer_PWM_ctrl);
    /* Handle error */
    if (FSP_SUCCESS != err)
    {
        return err;
    }
    /* Start GPT timer */
    err = R_GPT_Start(&g_timer_PWM_ctrl);;
    if(FSP_SUCCESS != err)
    {
        return err;
    }

    /* Set brightness (LCD backlight) level: 50 = (45+5) */
    g_gui_state.brightness = 45;
    brightness_up(&g_gui_state.brightness);

    return err;
}
