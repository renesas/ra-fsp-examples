#include "hal_data.h"
#include "sensor_algorithm_nsc.h"
#include "common_utils.h"
#include "app_definitions.h"

FSP_CPP_HEADER
void R_BSP_WarmStart(bsp_warm_start_event_t event);
FSP_CPP_FOOTER

void print_main_menu(void);

/*****************************************************************************************************************
 *  @brief      print_main_menu
 *              This function prints the user menu.
 *  @retval     none
 *  ****************************************************************************************************************/
void print_main_menu(void)
{
    APP_PRINT(MENUOPTION_MENU);

    /* Menu for User Selection */
    APP_PRINT(MENUOPTION1);
    APP_PRINT(MENUOPTION2);
}

/*******************************************************************************************************************//**
 * main() is generated by the RA Configuration editor and is used to generate threads if an RTOS is used.  This function
 * is called by main() when no RTOS is used.
 **********************************************************************************************************************/
void hal_entry(void)
{
    APP_PRINT(IN_NON_SECURE_REGION);
    print_main_menu();
    uint8_t readBuff[BUFF_SIZE] =  { RESET_VALUE };

    /* flag to stop algorithm execution when user has new input */
    volatile bool keep_running = true;

    while(true)
    {
        /* check if there is user manual item selection or button press on S1 */
        if (APP_CHECK_DATA)
        {
            uint32_t rByte = APP_READ(readBuff);

            /* function returns the converted integral number as an int value.*/
            int32_t inputRead = atoi((char *)readBuff);

            if (rByte > RESET_VALUE)
            {
                switch (inputRead)
                {
                    case START_IP_ALGORITHM:
                    {
                        APP_PRINT(MENUEVENT1);
                        keep_running = true;
                        while(keep_running == true)
                        {
                            sensor_algorithm_start_guard();
                            if (APP_CHECK_DATA)
                            {
                                break;
                            }
                        }
                    }
                    break;
                    case STOP_IP_ALGORITHM:
                    {
                        APP_PRINT(MENUEVENT2);
                        keep_running = false;
                        sensor_algorithm_stop_guard();
                    }
                    break;
                    default:
                    {
                        /* Menu for User Selection */
                        print_main_menu();
                    }
                    break;
                }
            }
        }
    }

#if BSP_TZ_SECURE_BUILD
    /* Enter non-secure code */
    R_BSP_NonSecureEnter();
#endif
}

/*******************************************************************************************************************//**
 * This function is called at various points during the startup process.  This implementation uses the event that is
 * called right before main() to set up the pins.
 *
 * @param[in]  event    Where at in the start up process the code is currently at
 **********************************************************************************************************************/
void R_BSP_WarmStart(bsp_warm_start_event_t event)
{
    if (BSP_WARM_START_RESET == event)
    {
#if BSP_FEATURE_FLASH_LP_VERSION != 0

        /* Enable reading from data flash. */
        R_FACI_LP->DFLCTL = 1U;

        /* Would normally have to wait tDSTOP(6us) for data flash recovery. Placing the enable here, before clock and
         * C runtime initialization, should negate the need for a delay since the initialization will typically take more than 6us. */
#endif
    }

    if (BSP_WARM_START_POST_C == event)
    {
        /* C runtime environment and system clocks are setup. */

        /* Configure pins. */
        R_IOPORT_Open (&IOPORT_CFG_CTRL, &IOPORT_CFG_NAME);

#if BSP_CFG_SDRAM_ENABLED

        /* Setup SDRAM and initialize it. Must configure pins first. */
        R_BSP_SdramInit(true);
#endif
    }
}

#if BSP_TZ_SECURE_BUILD

FSP_CPP_HEADER
BSP_CMSE_NONSECURE_ENTRY void template_nonsecure_callable ();

/* Trustzone Secure Projects require at least one nonsecure callable function in order to build (Remove this if it is not required to build). */
BSP_CMSE_NONSECURE_ENTRY void template_nonsecure_callable ()
{

}
FSP_CPP_FOOTER

#endif
