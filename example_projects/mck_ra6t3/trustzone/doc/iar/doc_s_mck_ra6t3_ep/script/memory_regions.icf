  /* generated memory regions file - do not edit */
  define symbol RAM_START = 0x20000000;
  define symbol RAM_LENGTH = 0x0000a000;
  define symbol FLASH_START = 0x00000000;
  define symbol FLASH_LENGTH = 0x00040000;
  define symbol DATA_FLASH_START = 0x08000000;
  define symbol DATA_FLASH_LENGTH = 0x00001000;
  define symbol OPTION_SETTING_OFS0_START = 0x0100a100;
  define symbol OPTION_SETTING_OFS0_LENGTH = 0x00000004;
  define symbol OPTION_SETTING_OSIS_START = 0x0100a120;
  define symbol OPTION_SETTING_OSIS_LENGTH = 0x00000010;
  define symbol OPTION_SETTING_OFS1_SEC_START = 0x0100a200;
  define symbol OPTION_SETTING_OFS1_SEC_LENGTH = 0x00000004;
  define symbol OPTION_SETTING_BPS_SEC_START = 0x0100a240;
  define symbol OPTION_SETTING_BPS_SEC_LENGTH = 0x00000004;
  define symbol OPTION_SETTING_PBPS_SEC_START = 0x0100a260;
  define symbol OPTION_SETTING_PBPS_SEC_LENGTH = 0x00000004;
