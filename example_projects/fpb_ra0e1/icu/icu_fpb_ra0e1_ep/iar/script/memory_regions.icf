
            /* generated memory regions file - do not edit */
                            define symbol RAM_START = 0x20004000;
                define symbol RAM_LENGTH   = 0x3000;
                define symbol FLASH_START = 0x00000000;
                define symbol FLASH_LENGTH   = 0x10000;
                define symbol DATA_FLASH_START = 0x40100000;
                define symbol DATA_FLASH_LENGTH   = 0x400;
                define symbol OPTION_SETTING_START = 0x00000000;
                define symbol OPTION_SETTING_LENGTH   = 0x0;
                define symbol OPTION_SETTING_S_START = 0x80000000;
                define symbol OPTION_SETTING_S_LENGTH   = 0x0;
                define symbol ID_CODE_START = 0x01010018;
                define symbol ID_CODE_LENGTH   = 0x20;
                define symbol SDRAM_START = 0x80010000;
                define symbol SDRAM_LENGTH   = 0x0;
                define symbol QSPI_FLASH_START = 0x60000000;
                define symbol QSPI_FLASH_LENGTH   = 0x0;
                define symbol OSPI_DEVICE_0_START = 0x80020000;
                define symbol OSPI_DEVICE_0_LENGTH   = 0x0;
                define symbol OSPI_DEVICE_1_START = 0x80030000;
                define symbol OSPI_DEVICE_1_LENGTH   = 0x0;
