  /* generated memory regions file - do not edit */
  define symbol RAM_START = 0x32002000;
  define symbol RAM_LENGTH = 0x000de000;
  define symbol FLASH_START = 0x12008000;
  define symbol FLASH_LENGTH = 0x001f0000;
  define symbol DATA_FLASH_START = 0x37000000;
  define symbol DATA_FLASH_LENGTH = 0x00003000;
  define symbol ITCM_START = 0x10000000;
  define symbol ITCM_LENGTH = 0x00010000;
  define symbol DTCM_START = 0x30000000;
  define symbol DTCM_LENGTH = 0x00010000;
  define symbol SDRAM_START = 0x68000000;
  define symbol SDRAM_LENGTH = 0x08000000;
  define symbol OSPI0_CS0_START = 0x80000000;
  define symbol OSPI0_CS0_LENGTH = 0x10000000;
  define symbol OSPI0_CS1_START = 0x90000000;
  define symbol OSPI0_CS1_LENGTH = 0x10000000;
  define symbol OPTION_SETTING_OFS1_START = 0x1300a180;
  define symbol OPTION_SETTING_OFS1_LENGTH = 0x00000004;
  define symbol OPTION_SETTING_BANKSEL_START = 0x1300a190;
  define symbol OPTION_SETTING_BANKSEL_LENGTH = 0x00000004;
  define symbol OPTION_SETTING_BPS_START = 0x1300a1c0;
  define symbol OPTION_SETTING_BPS_LENGTH = 0x00000010;
  define symbol OPTION_SETTING_PBPS_START = 0x1300a1e0;
  define symbol OPTION_SETTING_PBPS_LENGTH = 0x00000010;
