  /* generated memory regions file - do not edit */
  define symbol RAM_START = 0x1ffe0000;
  define symbol RAM_LENGTH = 0x00060000;
  define symbol FLASH_START = 0x00000440;
  define symbol FLASH_LENGTH = 0x000ffbc0;
  define symbol DATA_FLASH_START = 0x40100000;
  define symbol DATA_FLASH_LENGTH = 0x00008000;
  define symbol QSPI_FLASH_START = 0x60000000;
  define symbol QSPI_FLASH_LENGTH = 0x04000000;
  define symbol SDRAM_START = 0x90000000;
  define symbol SDRAM_LENGTH = 0x08000000;
  define symbol OPTION_SETTING_OFS0_START = 0x00000400;
  define symbol OPTION_SETTING_OFS0_LENGTH = 0x00000004;
  define symbol OPTION_SETTING_OFS1_START = 0x00000404;
  define symbol OPTION_SETTING_OFS1_LENGTH = 0x00000004;
  define symbol OPTION_SETTING_SECMPU_START = 0x00000408;
  define symbol OPTION_SETTING_SECMPU_LENGTH = 0x00000034;
  define symbol OPTION_SETTING_OSIS_START = 0x0100a150;
  define symbol OPTION_SETTING_OSIS_LENGTH = 0x00000010;
  define symbol FLASH_GAP_START = 0x00000000;
  define symbol FLASH_GAP_LENGTH = 0x00000400;
