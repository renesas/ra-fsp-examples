  /* generated memory regions file - do not edit */
  define symbol RAM_START = 0x20002000;
  define symbol RAM_LENGTH = 0x00016000;
  define symbol FLASH_START = 0x00008000;
  define symbol FLASH_LENGTH = 0x00078000;
  define symbol DATA_FLASH_START = 0x08000000;
  define symbol DATA_FLASH_LENGTH = 0x00002000;
  define symbol QSPI_FLASH_START = 0x60000000;
  define symbol QSPI_FLASH_LENGTH = 0x08000000;
  define symbol OPTION_SETTING_OFS1_START = 0x0100a180;
  define symbol OPTION_SETTING_OFS1_LENGTH = 0x00000004;
  define symbol OPTION_SETTING_BANKSEL_START = 0x0100a190;
  define symbol OPTION_SETTING_BANKSEL_LENGTH = 0x00000004;
  define symbol OPTION_SETTING_BPS_START = 0x0100a1c0;
  define symbol OPTION_SETTING_BPS_LENGTH = 0x0000000c;
  define symbol OPTION_SETTING_PBPS_START = 0x0100a1e0;
  define symbol OPTION_SETTING_PBPS_LENGTH = 0x0000000c;
