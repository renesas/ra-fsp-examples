  /* generated memory regions file - do not edit */
  define symbol RAM_START = 0x20002000;
  define symbol RAM_LENGTH = 0x00008000;
  define symbol FLASH_START = 0x00008000;
  define symbol FLASH_LENGTH = 0x00038000;
  define symbol DATA_FLASH_START = 0x08000000;
  define symbol DATA_FLASH_LENGTH = 0x00001000;
  define symbol QSPI_FLASH_START = 0x60000000;
  define symbol QSPI_FLASH_LENGTH = 0x04000000;
