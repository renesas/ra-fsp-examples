  /* generated memory regions file - do not edit */
  define symbol RAM_START = 0x20000000;
  define symbol RAM_LENGTH = 0x00010000;
  define symbol FLASH_START = 0x00000000;
  define symbol FLASH_LENGTH = 0x00080000;
  define symbol DATA_FLASH_START = 0x08000000;
  define symbol DATA_FLASH_LENGTH = 0x00004000;
  define symbol OPTION_SETTING_OFS0_START = 0x0100a100;
  define symbol OPTION_SETTING_OFS0_LENGTH = 0x00000004;
  define symbol OPTION_SETTING_OFS1_START = 0x0100a180;
  define symbol OPTION_SETTING_OFS1_LENGTH = 0x00000004;
  define symbol OPTION_SETTING_BPS_START = 0x0100a1c0;
  define symbol OPTION_SETTING_BPS_LENGTH = 0x00000004;
  define symbol OPTION_SETTING_PBPS_START = 0x0100a1e0;
  define symbol OPTION_SETTING_PBPS_LENGTH = 0x00000004;
  define symbol OPTION_SETTING_OFS1_SEC_START = 0x0100a200;
  define symbol OPTION_SETTING_OFS1_SEC_LENGTH = 0x00000004;
  define symbol OPTION_SETTING_BPS_SEC_START = 0x0100a240;
  define symbol OPTION_SETTING_BPS_SEC_LENGTH = 0x00000004;
  define symbol OPTION_SETTING_PBPS_SEC_START = 0x0100a260;
  define symbol OPTION_SETTING_PBPS_SEC_LENGTH = 0x0000000c;
  define symbol OPTION_SETTING_OFS1_SEL_START = 0x0100a280;
  define symbol OPTION_SETTING_OFS1_SEL_LENGTH = 0x00000004;
  define symbol OPTION_SETTING_BPS_SEL_START = 0x0100a2c0;
  define symbol OPTION_SETTING_BPS_SEL_LENGTH = 0x00000004;
