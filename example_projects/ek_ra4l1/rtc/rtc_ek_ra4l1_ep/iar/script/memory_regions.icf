
            /* generated memory regions file - do not edit */
                            define symbol RAM_START = 0x20000000;
                define symbol RAM_LENGTH   = 0x10000;
                define symbol FLASH_START = 0x00000000;
                define symbol FLASH_LENGTH   = 0x80000;
                define symbol DATA_FLASH_START = 0x08000000;
                define symbol DATA_FLASH_LENGTH   = 0x2000;
                define symbol OPTION_SETTING_START = 0x0100A100;
                define symbol OPTION_SETTING_LENGTH   = 0x100;
                define symbol OPTION_SETTING_S_START = 0x0100A200;
                define symbol OPTION_SETTING_S_LENGTH   = 0x100;
                define symbol ID_CODE_START = 0x00000000;
                define symbol ID_CODE_LENGTH   = 0x0;
                define symbol SDRAM_START = 0x80010000;
                define symbol SDRAM_LENGTH   = 0x0;
                define symbol QSPI_FLASH_START = 0x60000000;
                define symbol QSPI_FLASH_LENGTH   = 0x4000000;
                define symbol OSPI_DEVICE_0_START = 0x80020000;
                define symbol OSPI_DEVICE_0_LENGTH   = 0x0;
                define symbol OSPI_DEVICE_1_START = 0x80030000;
                define symbol OSPI_DEVICE_1_LENGTH   = 0x0;
