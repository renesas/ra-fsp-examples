  /* generated memory regions file - do not edit */
  define symbol RAM_START = 0x20004000;
  define symbol RAM_LENGTH = 0x00004000;
  define symbol FLASH_START = 0x00000440;
  define symbol FLASH_LENGTH = 0x0000fbc0;
  define symbol DATA_FLASH_START = 0x40100000;
  define symbol DATA_FLASH_LENGTH = 0x00000400;
  define symbol OPTION_SETTING_OFS0_START = 0x00000400;
  define symbol OPTION_SETTING_OFS0_LENGTH = 0x00000004;
  define symbol OPTION_SETTING_OFS1_START = 0x00000404;
  define symbol OPTION_SETTING_OFS1_LENGTH = 0x00000004;
  define symbol OPTION_SETTING_OSIS_START = 0x01010018;
  define symbol OPTION_SETTING_OSIS_LENGTH = 0x00000020;
  define symbol FLASH_GAP_START = 0x00000000;
  define symbol FLASH_GAP_LENGTH = 0x00000400;
