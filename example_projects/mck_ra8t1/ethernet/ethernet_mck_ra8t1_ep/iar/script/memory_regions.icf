
            /* generated memory regions file - do not edit */
                            define symbol RAM_START = 0x22000000;
                define symbol RAM_LENGTH   = 0xE0000;
                define symbol FLASH_START = 0x02000000;
                define symbol FLASH_LENGTH   = 0x1F8000;
                define symbol DATA_FLASH_START = 0x27000000;
                define symbol DATA_FLASH_LENGTH   = 0x3000;
                define symbol OPTION_SETTING_START = 0x0300A100;
                define symbol OPTION_SETTING_LENGTH   = 0x100;
                define symbol OPTION_SETTING_S_START = 0x0300A200;
                define symbol OPTION_SETTING_S_LENGTH   = 0x100;
                define symbol OPTION_SETTING_DATA_FLASH_S_START = 0x27030080;
                define symbol OPTION_SETTING_DATA_FLASH_S_LENGTH   = 0x800;
                define symbol ID_CODE_START = 0x00000000;
                define symbol ID_CODE_LENGTH   = 0x0;
                define symbol SDRAM_START = 0x68000000;
                define symbol SDRAM_LENGTH   = 0x8000000;
                define symbol QSPI_FLASH_START = 0x60000000;
                define symbol QSPI_FLASH_LENGTH   = 0x0;
                define symbol OSPI_DEVICE_0_START = 0x80000000;
                define symbol OSPI_DEVICE_0_LENGTH   = 0x10000000;
                define symbol OSPI_DEVICE_1_START = 0x90000000;
                define symbol OSPI_DEVICE_1_LENGTH   = 0x10000000;
                define symbol ITCM_START = 0x00000000;
                define symbol ITCM_LENGTH   = 0x10000;
                define symbol DTCM_START = 0x20000000;
                define symbol DTCM_LENGTH   = 0x10000;
                define symbol NS_OFFSET_START = 0x10000000;
                define symbol NS_OFFSET_LENGTH   = 0x0;
                    define symbol RAM_NS_BUFFER_LENGTH = 0xC20;
