  /* generated memory regions file - do not edit */
  define symbol RAM_START = 0x22000000;
  define symbol RAM_LENGTH = 0x000e0000;
  define symbol FLASH_START = 0x02000000;
  define symbol FLASH_LENGTH = 0x001f8000;
  define symbol DATA_FLASH_START = 0x27000000;
  define symbol DATA_FLASH_LENGTH = 0x00003000;
  define symbol SDRAM_START = 0x68000000;
  define symbol SDRAM_LENGTH = 0x08000000;
  define symbol OPTION_SETTING_OFS0_START = 0x0300a100;
  define symbol OPTION_SETTING_OFS0_LENGTH = 0x00000004;
  define symbol OPTION_SETTING_OFS2_START = 0x0300a104;
  define symbol OPTION_SETTING_OFS2_LENGTH = 0x00000004;
  define symbol OPTION_SETTING_DUALSEL_START = 0x0300a110;
  define symbol OPTION_SETTING_DUALSEL_LENGTH = 0x00000004;
  define symbol OPTION_SETTING_OFS1_START = 0x1300a180;
  define symbol OPTION_SETTING_OFS1_LENGTH = 0x00000004;
  define symbol OPTION_SETTING_BANKSEL_START = 0x1300a190;
  define symbol OPTION_SETTING_BANKSEL_LENGTH = 0x00000004;
  define symbol OPTION_SETTING_BPS_START = 0x1300a1c0;
  define symbol OPTION_SETTING_BPS_LENGTH = 0x00000010;
  define symbol OPTION_SETTING_PBPS_START = 0x1300a1e0;
  define symbol OPTION_SETTING_PBPS_LENGTH = 0x00000010;
  define symbol OPTION_SETTING_OFS1_SEC_START = 0x0300a200;
  define symbol OPTION_SETTING_OFS1_SEC_LENGTH = 0x00000004;
  define symbol OPTION_SETTING_BANKSEL_SEC_START = 0x0300a210;
  define symbol OPTION_SETTING_BANKSEL_SEC_LENGTH = 0x00000004;
  define symbol OPTION_SETTING_BPS_SEC_START = 0x0300a240;
  define symbol OPTION_SETTING_BPS_SEC_LENGTH = 0x00000010;
  define symbol OPTION_SETTING_PBPS_SEC_START = 0x0300a260;
  define symbol OPTION_SETTING_PBPS_SEC_LENGTH = 0x00000010;
  define symbol OPTION_SETTING_OFS1_SEL_START = 0x0300a280;
  define symbol OPTION_SETTING_OFS1_SEL_LENGTH = 0x00000004;
  define symbol OPTION_SETTING_BANKSEL_SEL_START = 0x0300a290;
  define symbol OPTION_SETTING_BANKSEL_SEL_LENGTH = 0x00000004;
  define symbol OPTION_SETTING_BPS_SEL_START = 0x0300a2c0;
  define symbol OPTION_SETTING_BPS_SEL_LENGTH = 0x00000010;
  define symbol OPTION_SETTING_DATA_FLASH_FSBLCTRL0_START = 0x27030080;
  define symbol OPTION_SETTING_DATA_FLASH_FSBLCTRL0_LENGTH = 0x00000004;
  define symbol OPTION_SETTING_DATA_FLASH_FSBLCTRL1_START = 0x27030084;
  define symbol OPTION_SETTING_DATA_FLASH_FSBLCTRL1_LENGTH = 0x00000004;
  define symbol OPTION_SETTING_DATA_FLASH_FSBLCTRL2_START = 0x27030088;
  define symbol OPTION_SETTING_DATA_FLASH_FSBLCTRL2_LENGTH = 0x00000004;
  define symbol OPTION_SETTING_DATA_FLASH_SACC0_START = 0x2703008c;
  define symbol OPTION_SETTING_DATA_FLASH_SACC0_LENGTH = 0x00000004;
  define symbol OPTION_SETTING_DATA_FLASH_SACC1_START = 0x27030090;
  define symbol OPTION_SETTING_DATA_FLASH_SACC1_LENGTH = 0x00000004;
  define symbol OPTION_SETTING_DATA_FLASH_SAMR_START = 0x27030094;
  define symbol OPTION_SETTING_DATA_FLASH_SAMR_LENGTH = 0x00000004;
  define symbol ITCM_START = 0x00000000;
  define symbol ITCM_LENGTH = 0x00010000;
  define symbol DTCM_START = 0x20000000;
  define symbol DTCM_LENGTH = 0x00010000;
