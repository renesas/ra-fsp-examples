0x33444d00, "x-world/x-3dmf", 0x01,
0x33444d46, "x-world/x-3dmf", 0x01,
0x41000000, "application/octet-stream", 0x01,
0x41414200, "application/x-authorware-bin", 0x01,
0x41414d00, "application/x-authorware-map", 0x01,
0x41415300, "application/x-authorware-seg", 0x01,
0x41424300, "text/vnd.abc", 0x00,
0x41434749, "text/html", 0x00,
0x41464c00, "video/animaflex", 0x01,
0x41490000, "application/postscript", 0x01,
0x41494600, "audio/aiff", 0x01,
0x41494643, "audio/aiff", 0x01,
0x41494646, "audio/aiff", 0x01,
0x41494d00, "application/x-aim", 0x01,
0x41495000, "text/x-audiosoft-intra", 0x00,
0x414e4900, "application/x-navi-animation", 0x01,
0x414f5300, "application/x-nokia-9000-communicator-add-on-software", 0x01,
0x41505300, "application/mime", 0x01,
0x41524300, "application/octet-stream", 0x01,
0x41524a00, "application/octet-stream", 0x01,
0x41525400, "image/x-jg", 0x01,
0x41534600, "video/x-ms-asf", 0x01,
0x41534d00, "text/x-asm", 0x00,
0x41535000, "text/asp", 0x00,
0x41535800, "application/x-mplayer2", 0x01,
0x41550000, "audio/basic", 0x01,
0x41564900, "video/msvideo", 0x01,
0x41565300, "video/avs-video", 0x01,
0x42494e00, "application/octet-stream", 0x01,
0x424d0000, "image/bmp", 0x01,
0x424d5000, "image/bmp", 0x01,
0x424f4f00, "application/book", 0x01,
0x424f4f4b, "application/book", 0x01,
0x424f5a00, "application/x-bzip2", 0x01,
0x42534800, "application/x-bsh", 0x01,
0x425a0000, "application/x-bzip", 0x01,
0x425a3200, "application/x-bzip2", 0x01,
0x43000000, "text/plain", 0x00,
0x432b2b00, "text/plain", 0x00,
0x43415400, "application/vnd.ms-pki.seccat", 0x01,
0x43430000, "text/plain", 0x00,
0x43434144, "application/clariscad", 0x01,
0x43434f00, "application/x-cocoa", 0x01,
0x43444600, "application/cdf", 0x01,
0x43455200, "application/pkix-cert", 0x01,
0x43484100, "application/x-chat", 0x01,
0x43484154, "application/x-chat", 0x01,
0x43474900, "text/html", 0x00,
0x434c4153, "application/java", 0x01,
0x434f4d00, "application/octet-stream", 0x01,
0x434f4d00, "text/plain", 0x00,
0x434f4e46, "text/plain", 0x00,
0x4350494f, "application/x-cpio", 0x01,
0x43505000, "text/x-c", 0x00,
0x43505400, "application/mac-compactpro", 0x01,
0x43524c00, "application/pkcs-crl", 0x01,
0x43525400, "application/pkix-cert", 0x01,
0x43534800, "application/x-csh", 0x01,
0x43535300, "text/css", 0x00,
0x43585800, "text/plain", 0x00,
0x44435200, "application/x-director", 0x01,
0x44454600, "text/plain", 0x00,
0x44455200, "application/x-x509-ca-cert", 0x01,
0x44494600, "video/x-dv", 0x01,
0x44495200, "application/x-director", 0x01,
0x444c0000, "video/dl", 0x01,
0x444c0000, "video/x-dl", 0x01,
0x444f4300, "application/msword", 0x01,
0x444f5400, "application/msword", 0x01,
0x44500000, "application/commonground", 0x01,
0x44525700, "application/drafting", 0x01,
0x44554d50, "application/octet-stream", 0x01,
0x44560000, "video/x-dv", 0x01,
0x44564900, "application/x-dvi", 0x01,
0x44574600, "drawing/x-dwf", 0x01,
0x44574700, "application/acad", 0x01,
0x44584600, "application/dxf", 0x01,
0x44585200, "application/x-director", 0x01,
0x454c0000, "text/x-script.elisp", 0x00,
0x454c4300, "application/x-bytecode.elisp", 0x01,
0x454e5600, "application/x-envoy", 0x01,
0x45505300, "application/postscript", 0x01,
0x45530000, "application/x-esrehber", 0x01,
0x45545800, "text/x-setext", 0x00,
0x45565900, "application/envoy", 0x01,
0x45584500, "application/octet-stream", 0x01,
0x46000000, "text/plain", 0x00,
0x46373700, "text/x-fortran", 0x00,
0x46393000, "text/plain", 0x00,
0x46393000, "text/x-fortran", 0x00,
0x46444600, "application/vnd.fdf", 0x01,
0x46494600, "application/fractals", 0x01,
0x464c4900, "video/fli", 0x01,
0x464c4f00, "image/florian", 0x01,
0x464c5800, "text/vnd.fmi.flexstor", 0x00,
0x464d4600, "video/x-atomic3d-feature", 0x01,
0x464f5200, "text/plain", 0x00,
0x464f5200, "text/x-fortran", 0x00,
0x46505800, "image/vnd.fpx", 0x01,
0x46505800, "image/vnd.net-fpx", 0x01,
0x46524c00, "application/freeloader", 0x01,
0x46554e4b, "audio/make", 0x01,
0x47000000, "text/plain", 0x00,
0x47330000, "image/g3fax", 0x01,
0x47494600, "image/gif", 0x01,
0x474c0000, "video/gl", 0x01,
0x474c0000, "video/x-gl", 0x01,
0x47534400, "audio/x-gsm", 0x01,
0x47534d00, "audio/x-gsm", 0x01,
0x47535000, "application/x-gsp", 0x01,
0x47535300, "application/x-gss", 0x01,
0x47544152, "application/x-gtar", 0x01,
0x475a0000, "application/x-compressed", 0x01,
0x475a0000, "application/x-gzip", 0x01,
0x475a4950, "application/x-gzip", 0x01,
0x475a4950, "multipart/x-gzip", 0x01,
0x48000000, "text/plain", 0x00,
0x48000000, "text/x-h", 0x00,
0x48444600, "application/x-hdf", 0x01,
0x48454c50, "application/x-helpfile", 0x01,
0x48474c00, "application/vnd.hp-hpgl", 0x01,
0x48480000, "text/plain", 0x00,
0x48480000, "text/x-h", 0x00,
0x484c4200, "text/x-script", 0x00,
0x484c5000, "application/hlp", 0x01,
0x48504700, "application/vnd.hp-hpgl", 0x01,
0x4850474c, "application/vnd.hp-hpgl", 0x01,
0x48515800, "application/binhex", 0x01,
0x48544100, "application/hta", 0x01,
0x48544300, "text/x-component", 0x00,
0x48544d00, "text/html", 0x00,
0x48544d4c, "text/html", 0x00,
0x48545400, "text/webviewhtml", 0x00,
0x48545800, "text/html", 0x00,
0x49434500, "x-conference/x-cooltalk", 0x01,
0x49434f00, "image/x-icon", 0x01,
0x49444300, "text/plain", 0x00,
0x49454600, "image/ief", 0x01,
0x49454653, "image/ief", 0x01,
0x49474553, "application/iges", 0x01,
0x49475300, "application/iges", 0x01,
0x494d4100, "application/x-ima", 0x01,
0x494d4150, "application/x-httpd-imap", 0x01,
0x494e4600, "application/inf", 0x01,
0x494e4900, "text/plain", 0x00,
0x494e5300, "application/x-internett-signup", 0x01,
0x49500000, "application/x-ip2", 0x01,
0x49535500, "video/x-isvideo", 0x01,
0x49540000, "audio/it", 0x01,
0x49560000, "application/x-inventor", 0x01,
0x49565200, "i-world/i-vrml", 0x01,
0x49565900, "application/x-livescreen", 0x01,
0x4a414d00, "audio/x-jam", 0x01,
0x4a415600, "text/plain", 0x00,
0x4a415641, "text/plain", 0x00,
0x4a434d00, "application/x-java-commerce", 0x01,
0x4a464946, "image/jpeg", 0x01,
0x4a504500, "image/jpeg", 0x01,
0x4a504547, "image/jpeg", 0x01,
0x4a504700, "image/jpeg", 0x01,
0x4a505300, "image/x-jps", 0x01,
0x4a530000, "application/x-javascript", 0x01,
0x4a555400, "image/jutvision", 0x01,
0x4b415200, "audio/midi", 0x01,
0x4b415200, "music/x-karaoke", 0x01,
0x4b534800, "application/x-ksh", 0x01,
0x4b534800, "text/x-script.ksh", 0x00,
0x4c410000, "audio/nspaudio", 0x01,
0x4c410000, "audio/x-nspaudio", 0x01,
0x4c414d00, "audio/x-liveaudio", 0x01,
0x4c484100, "application/lha", 0x01,
0x4c484100, "application/octet-stream", 0x01,
0x4c484100, "application/x-lha", 0x01,
0x4c485800, "application/octet-stream", 0x01,
0x4c495354, "text/plain", 0x00,
0x4c4d4100, "audio/nspaudio", 0x01,
0x4c4d4100, "audio/x-nspaudio", 0x01,
0x4c4f4700, "text/plain", 0x00,
0x4c535000, "application/x-lisp", 0x01,
0x4c535400, "text/plain", 0x00,
0x4c535800, "text/x-la-asf", 0x00,
0x4c545800, "application/x-latex", 0x01,
0x4c5a4800, "application/octet-stream", 0x01,
0x4c5a5800, "application/lzx", 0x01,
0x4d000000, "text/plain", 0x00,
0x4d000000, "text/x-m", 0x00,
0x4d315600, "video/mpeg", 0x01,
0x4d324100, "audio/mpeg", 0x01,
0x4d325600, "video/mpeg", 0x01,
0x4d335500, "audio/x-mpequrl", 0x01,
0x4d414e00, "application/x-troff-man", 0x01,
0x4d415000, "application/x-navimap", 0x01,
0x4d415200, "text/plain", 0x00,
0x4d424400, "application/mbedlet", 0x01,
0x4d432400, "application/x-magic-cap-package-1.0", 0x01,
0x4d434400, "application/mcad", 0x01,
0x4d434600, "image/vasa", 0x01,
0x4d435000, "application/netmc", 0x01,
0x4d450000, "application/x-troff-me", 0x01,
0x4d485400, "message/rfc822", 0x01,
0x4d494400, "application/x-midi", 0x01,
0x4d494449, "application/x-midi", 0x01,
0x4d494600, "application/x-frame", 0x01,
0x4d494d45, "message/rfc822", 0x01,
0x4d4a4600, "audio/x-vnd.audioexplosion.mjuicemediafile", 0x01,
0x4d4a5047, "video/x-motion-jpeg", 0x01,
0x4d4d0000, "application/base64", 0x01,
0x4d4d4500, "application/base64", 0x01,
0x4d4f4400, "audio/mod", 0x01,
0x4d4f4f56, "video/quicktime", 0x01,
0x4d4f5600, "video/quicktime", 0x01,
0x4d503200, "audio/mpeg", 0x01,
0x4d503300, "audio/mpeg3", 0x01,
0x4d503400, "video/mp4", 0x01,
0x4d504100, "audio/mpeg", 0x01,
0x4d504300, "application/x-project", 0x01,
0x4d504547, "video/mpeg", 0x01,
0x4d504741, "audio/mpeg", 0x01,
0x4d505000, "application/vnd.ms-project", 0x01,
0x4d505400, "application/x-project", 0x01,
0x4d505600, "application/x-project", 0x01,
0x4d505800, "application/x-project", 0x01,
0x4d524300, "application/marc", 0x01,
0x4d530000, "application/x-troff-ms", 0x01,
0x4d560000, "video/x-sgi-movie", 0x01,
0x4d590000, "audio/make", 0x01,
0x4d5a5a00, "application/x-vnd.audioexplosion.mzz", 0x01,
0x4e415000, "image/naplps", 0x01,
0x4e430000, "application/x-netcdf", 0x01,
0x4e434d00, "application/vnd.nokia.configuration-message", 0x01,
0x4e494600, "image/x-niff", 0x01,
0x4e494646, "image/x-niff", 0x01,
0x4e495800, "application/x-mix-transfer", 0x01,
0x4e534300, "application/x-conference", 0x01,
0x4e564400, "application/x-navidoc", 0x01,
0x4f000000, "application/octet-stream", 0x01,
0x4f444100, "application/oda", 0x01,
0x4f4d4300, "application/x-omc", 0x01,
0x4f4d4344, "application/x-omcdatamaker", 0x01,
0x4f4d4352, "application/x-omcregerator", 0x01,
0x50000000, "text/x-pascal", 0x00,
0x50313000, "application/pkcs10", 0x01,
0x50313000, "application/x-pkcs10", 0x01,
0x50313200, "application/pkcs-12", 0x01,
0x50313200, "application/x-pkcs12", 0x01,
0x50374100, "application/x-pkcs7-signature", 0x01,
0x50374300, "application/pkcs7-mime", 0x01,
0x50374d00, "application/pkcs7-mime", 0x01,
0x50375200, "application/x-pkcs7-certreqresp", 0x01,
0x50375300, "application/pkcs7-signature", 0x01,
0x50415254, "application/pro_eng", 0x01,
0x50415300, "text/pascal", 0x00,
0x50424d00, "image/x-portable-bitmap", 0x01,
0x50434c00, "application/vnd.hp-pcl", 0x01,
0x50434c00, "application/x-pcl", 0x01,
0x50435400, "image/x-pict", 0x01,
0x50435800, "image/x-pcx", 0x01,
0x50444200, "chemical/x-pdb", 0x01,
0x50444600, "application/pdf", 0x01,
0x50474d00, "image/x-portable-graymap", 0x01,
0x50474d00, "image/x-portable-greymap", 0x01,
0x50494300, "image/pict", 0x01,
0x50494354, "image/pict", 0x01,
0x504b4700, "application/x-newton-compatible-pkg", 0x01,
0x504b4f00, "application/vnd.ms-pki.pko", 0x01,
0x504c0000, "text/plain", 0x00,
0x504c0000, "text/x-script.perl", 0x00,
0x504c5800, "application/x-pixclscript", 0x01,
0x504d0000, "image/x-xpixmap", 0x01,
0x504d0000, "text/x-script.perl-module", 0x00,
0x504d3400, "application/x-pagemaker", 0x01,
0x504d3500, "application/x-pagemaker", 0x01,
0x504e4700, "image/png", 0x01,
0x504e4d00, "application/x-portable-anymap", 0x01,
0x504e4d00, "image/x-portable-anymap", 0x01,
0x504f5400, "application/mspowerpoint", 0x01,
0x504f5400, "application/vnd.ms-powerpoint", 0x01,
0x504f5600, "model/x-pov", 0x01,
0x50504100, "application/vnd.ms-powerpoint", 0x01,
0x50504d00, "image/x-portable-pixmap", 0x01,
0x50505300, "application/mspowerpoint", 0x01,
0x50505300, "application/vnd.ms-powerpoint", 0x01,
0x50505400, "application/mspowerpoint", 0x01,
0x50505400, "application/powerpoint", 0x01,
0x50505400, "application/vnd.ms-powerpoint", 0x01,
0x50505400, "application/x-mspowerpoint", 0x01,
0x50505a00, "application/mspowerpoint", 0x01,
0x50524500, "application/x-freelance", 0x01,
0x50525400, "application/pro_eng", 0x01,
0x50530000, "application/postscript", 0x01,
0x50534400, "application/octet-stream", 0x01,
0x50565500, "paleovu/x-pv", 0x01,
0x50575a00, "application/vnd.ms-powerpoint", 0x01,
0x50590000, "text/x-script.phyton", 0x00,
0x50594300, "applicaiton/x-bytecode.python", 0x01,
0x51435000, "audio/vnd.qcelp", 0x01,
0x51443300, "x-world/x-3dmf", 0x01,
0x51443344, "x-world/x-3dmf", 0x01,
0x51494600, "image/x-quicktime", 0x01,
0x51540000, "video/quicktime", 0x01,
0x51544300, "video/x-qtc", 0x01,
0x51544900, "image/x-quicktime", 0x01,
0x51544946, "image/x-quicktime", 0x01,
0x52410000, "audio/x-pn-realaudio", 0x01,
0x52410000, "audio/x-pn-realaudio-plugin", 0x01,
0x52410000, "audio/x-realaudio", 0x01,
0x52414d00, "audio/x-pn-realaudio", 0x01,
0x52415300, "application/x-cmu-raster", 0x01,
0x52415300, "image/cmu-raster", 0x01,
0x52415300, "image/x-cmu-raster", 0x01,
0x52415354, "image/cmu-raster", 0x01,
0x52455858, "text/x-script.rexx", 0x00,
0x52460000, "image/vnd.rn-realflash", 0x01,
0x52474200, "image/x-rgb", 0x01,
0x524d0000, "application/vnd.rn-realmedia", 0x01,
0x524d0000, "audio/x-pn-realaudio", 0x01,
0x524d4900, "audio/mid", 0x01,
0x524d4d00, "audio/x-pn-realaudio", 0x01,
0x524d5000, "audio/x-pn-realaudio", 0x01,
0x524d5000, "audio/x-pn-realaudio-plugin", 0x01,
0x524e4700, "application/ringing-tones", 0x01,
0x524e4700, "application/vnd.nokia.ringing-tone", 0x01,
0x524e5800, "application/vnd.rn-realplayer", 0x01,
0x524f4646, "application/x-troff", 0x01,
0x52500000, "image/vnd.rn-realpix", 0x01,
0x52504d00, "audio/x-pn-realaudio-plugin", 0x01,
0x52540000, "text/richtext", 0x00,
0x52540000, "text/vnd.rn-realtext", 0x00,
0x52544600, "application/rtf", 0x01,
0x52544600, "application/x-rtf", 0x01,
0x52544600, "text/richtext", 0x00,
0x52545800, "application/rtf", 0x01,
0x52545800, "text/richtext", 0x00,
0x52560000, "video/vnd.rn-realvideo", 0x01,
0x53000000, "text/x-asm", 0x00,
0x53334d00, "audio/s3m", 0x01,
0x53415645, "application/octet-stream", 0x01,
0x53424b00, "application/x-tbook", 0x01,
0x53434d00, "application/x-lotusscreencam", 0x01,
0x53434d00, "text/x-script.guile", 0x00,
0x53434d00, "text/x-script.scheme", 0x00,
0x53434d00, "video/x-scm", 0x01,
0x53444d4c, "text/plain", 0x00,
0x53445000, "application/sdp", 0x01,
0x53445000, "application/x-sdp", 0x01,
0x53445200, "application/sounder", 0x01,
0x53454100, "application/sea", 0x01,
0x53454100, "application/x-sea", 0x01,
0x53455400, "application/set", 0x01,
0x53474d00, "text/sgml", 0x00,
0x53474d00, "text/x-sgml", 0x00,
0x53474d4c, "text/sgml", 0x00,
0x53474d4c, "text/x-sgml", 0x00,
0x53480000, "application/x-bsh", 0x01,
0x53480000, "application/x-sh", 0x01,
0x53480000, "application/x-shar", 0x01,
0x53480000, "text/x-script.sh", 0x00,
0x53484152, "application/x-bsh", 0x01,
0x53484152, "application/x-shar", 0x01,
0x5348544d, "text/html", 0x00,
0x5348544d, "text/x-server-parsed-html", 0x00,
0x53494400, "audio/x-psid", 0x01,
0x53495400, "application/x-sit", 0x01,
0x534b4400, "application/x-koan", 0x01,
0x534b4d00, "application/x-koan", 0x01,
0x534b5000, "application/x-koan", 0x01,
0x534b5400, "application/x-koan", 0x01,
0x534c0000, "application/x-seelogo", 0x01,
0x534d4900, "application/smil", 0x01,
0x534d494c, "application/smil", 0x01,
0x534e4400, "audio/basic", 0x01,
0x534e4400, "audio/x-adpcm", 0x01,
0x534f4c00, "application/solids", 0x01,
0x53504300, "application/x-pkcs7-certificates", 0x01,
0x53504300, "text/x-speech", 0x00,
0x53504c00, "application/futuresplash", 0x01,
0x53505200, "application/x-sprite", 0x01,
0x53524300, "application/x-wais-source", 0x01,
0x53534900, "text/x-server-parsed-html", 0x00,
0x53534d00, "application/streamingmedia", 0x01,
0x53535400, "application/vnd.ms-pki.certstore", 0x01,
0x53544550, "application/step", 0x01,
0x53544c00, "application/sla", 0x01,
0x53544c00, "application/vnd.ms-pki.stl", 0x01,
0x53544c00, "application/x-navistyle", 0x01,
0x53545000, "application/step", 0x01,
0x53564600, "image/vnd.dwg", 0x01,
0x53565200, "application/x-world", 0x01,
0x53574600, "application/x-shockwave-flash", 0x01,
0x54000000, "application/x-troff", 0x01,
0x54414c4b, "text/x-speech", 0x00,
0x54415200, "application/x-tar", 0x01,
0x54424b00, "application/toolbook", 0x01,
0x54434c00, "application/x-tcl", 0x01,
0x54435348, "text/x-script.tcsh", 0x00,
0x54455800, "application/x-tex", 0x01,
0x54455849, "application/x-texinfo", 0x01,
0x54455854, "application/plain", 0x00,
0x54475a00, "application/gnutar", 0x01,
0x54494600, "image/tiff", 0x01,
0x54494646, "image/tiff", 0x01,
0x54520000, "application/x-troff", 0x01,
0x54534900, "audio/tsp-audio", 0x01,
0x54535000, "application/dsptype", 0x01,
0x54535000, "audio/tsplayer", 0x01,
0x54535600, "text/tab-separated-values", 0x00,
0x54585400, "text/plain", 0x00,
0x55494c00, "text/x-uil", 0x00,
0x554e4900, "text/uri-list", 0x00,
0x554e4953, "text/uri-list", 0x00,
0x554e5600, "application/i-deas", 0x01,
0x55524900, "text/uri-list", 0x00,
0x55524953, "text/uri-list", 0x00,
0x55535441, "application/x-ustar", 0x01,
0x55550000, "application/octet-stream", 0x01,
0x55554500, "text/x-uuencode", 0x00,
0x56434400, "application/x-cdlink", 0x01,
0x56435300, "text/x-vcalendar", 0x00,
0x56444100, "application/vda", 0x01,
0x56444f00, "video/vdo", 0x01,
0x56455700, "application/groupwise", 0x01,
0x56495600, "video/vivo", 0x01,
0x5649564f, "video/vivo", 0x01,
0x564d4400, "application/vocaltec-media-desc", 0x01,
0x564d4600, "application/vocaltec-media-file", 0x01,
0x564f4300, "audio/voc", 0x01,
0x564f5300, "video/vosaic", 0x01,
0x564f5800, "audio/voxware", 0x01,
0x56514500, "audio/x-twinvq-plugin", 0x01,
0x56514600, "audio/x-twinvq", 0x01,
0x56514c00, "audio/x-twinvq-plugin", 0x01,
0x56524d4c, "application/x-vrml", 0x01,
0x56524d4c, "model/vrml", 0x01,
0x56525400, "x-world/x-vrt", 0x01,
0x56534400, "application/x-visio", 0x01,
0x56535400, "application/x-visio", 0x01,
0x56535700, "application/x-visio", 0x01,
0x57363000, "application/wordperfect6.0", 0x01,
0x57363100, "application/wordperfect6.1", 0x01,
0x57365700, "application/msword", 0x01,
0x57415600, "audio/wav", 0x01,
0x57423100, "application/x-qpro", 0x01,
0x57424d50, "image/vnd.wap.wbmp", 0x01,
0x57454200, "application/vnd.xara", 0x01,
0x57495a00, "application/msword", 0x01,
0x574b3100, "application/x-123", 0x01,
0x574d4600, "windows/metafile", 0x01,
0x574d4c00, "text/vnd.wap.wml", 0x00,
0x574d4c43, "application/vnd.wap.wmlc", 0x01,
0x574d4c53, "text/vnd.wap.wmlscript", 0x00,
0x574d5600, "video/x-ms-wmv", 0x01,
0x574f5244, "application/msword", 0x01,
0x57500000, "application/wordperfect", 0x01,
0x57503500, "application/wordperfect", 0x01,
0x57503600, "application/wordperfect", 0x01,
0x57504400, "application/wordperfect", 0x01,
0x57513100, "application/x-lotus", 0x01,
0x57524900, "application/mswrite", 0x01,
0x57524c00, "application/x-world", 0x01,
0x57525a00, "model/vrml", 0x01,
0x57534300, "text/scriplet", 0x00,
0x57535243, "application/x-wais-source", 0x01,
0x57544b00, "application/x-wintalk", 0x01,
0x58424d00, "image/x-xbitmap", 0x01,
0x58445200, "video/x-amt-demorun", 0x01,
0x58475a00, "xgl/drawing", 0x01,
0x58494600, "image/vnd.xiff", 0x01,
0x584c0000, "application/excel", 0x01,
0x584c4100, "application/excel", 0x01,
0x584c4200, "application/excel", 0x01,
0x584c4300, "application/excel", 0x01,
0x584c4400, "application/excel", 0x01,
0x584c4b00, "application/excel", 0x01,
0x584c4c00, "application/excel", 0x01,
0x584c4d00, "application/excel", 0x01,
0x584c5300, "application/excel", 0x01,
0x584c5400, "application/excel", 0x01,
0x584c5600, "application/excel", 0x01,
0x584c5700, "application/excel", 0x01,
0x584d0000, "audio/xm", 0x01,
0x584d4c00, "text/xml", 0x00,
0x584d5a00, "xgl/movie", 0x01,
0x58504958, "application/x-vnd.ls-xpix", 0x01,
0x58504d00, "image/x-xpixmap", 0x01,
0x58535200, "video/x-amt-showrun", 0x01,
0x58574400, "image/x-xwd", 0x01,
0x58595a00, "chemical/x-pdb", 0x01,
0x5a000000, "application/x-compress", 0x01,
0x5a495000, "application/x-compressed", 0x01,
0x5a4f4f00, "application/octet-stream", 0x01,
0x5a534800, "text/x-script.zsh", 0x00,
