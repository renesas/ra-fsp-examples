  /* generated memory regions file - do not edit */
  define symbol RAM_START = 0x20000000;
  define symbol RAM_LENGTH = 0x00040000;
  define symbol FLASH_START = 0x00000000;
  define symbol FLASH_LENGTH = 0x00100000;
  define symbol DATA_FLASH_START = 0x08000000;
  define symbol DATA_FLASH_LENGTH = 0x00002000;
  define symbol QSPI_FLASH_START = 0x60000000;
  define symbol QSPI_FLASH_LENGTH = 0x04000000;
  define symbol OSPI0_CS0_START = 0x68000000;
  define symbol OSPI0_CS0_LENGTH = 0x08000000;
  define symbol OSPI0_CS1_START = 0x70000000;
  define symbol OSPI0_CS1_LENGTH = 0x10000000;
  define symbol OPTION_SETTING_OFS0_START = 0x0100a100;
  define symbol OPTION_SETTING_OFS0_LENGTH = 0x00000004;
  define symbol OPTION_SETTING_DUALSEL_START = 0x0100a110;
  define symbol OPTION_SETTING_DUALSEL_LENGTH = 0x00000004;
  define symbol OPTION_SETTING_OFS1_START = 0x0100a180;
  define symbol OPTION_SETTING_OFS1_LENGTH = 0x00000004;
  define symbol OPTION_SETTING_BANKSEL_START = 0x0100a190;
  define symbol OPTION_SETTING_BANKSEL_LENGTH = 0x00000004;
  define symbol OPTION_SETTING_BPS_START = 0x0100a1c0;
  define symbol OPTION_SETTING_BPS_LENGTH = 0x0000000c;
  define symbol OPTION_SETTING_PBPS_START = 0x0100a1e0;
  define symbol OPTION_SETTING_PBPS_LENGTH = 0x0000000c;
  define symbol OPTION_SETTING_OFS1_SEC_START = 0x0100a200;
  define symbol OPTION_SETTING_OFS1_SEC_LENGTH = 0x00000004;
  define symbol OPTION_SETTING_BANKSEL_SEC_START = 0x0100a210;
  define symbol OPTION_SETTING_BANKSEL_SEC_LENGTH = 0x00000004;
  define symbol OPTION_SETTING_BPS_SEC_START = 0x0100a240;
  define symbol OPTION_SETTING_BPS_SEC_LENGTH = 0x0000000c;
  define symbol OPTION_SETTING_PBPS_SEC_START = 0x0100a260;
  define symbol OPTION_SETTING_PBPS_SEC_LENGTH = 0x0000000c;
  define symbol OPTION_SETTING_OFS1_SEL_START = 0x0100a280;
  define symbol OPTION_SETTING_OFS1_SEL_LENGTH = 0x00000004;
  define symbol OPTION_SETTING_BANKSEL_SEL_START = 0x0100a290;
  define symbol OPTION_SETTING_BANKSEL_SEL_LENGTH = 0x00000004;
  define symbol OPTION_SETTING_BPS_SEL_START = 0x0100a2c0;
  define symbol OPTION_SETTING_BPS_SEL_LENGTH = 0x0000000c;
