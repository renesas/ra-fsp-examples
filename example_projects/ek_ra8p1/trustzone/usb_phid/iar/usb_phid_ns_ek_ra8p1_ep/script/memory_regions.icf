  /* generated memory regions file - do not edit */
  define symbol RAM_START = 0x32002000;
  define symbol RAM_LENGTH = 0x001d2000;
  define symbol FLASH_START = 0x12008000;
  define symbol FLASH_LENGTH = 0x000f8000;
  define symbol DATA_FLASH_START = 0x37000000;
  define symbol DATA_FLASH_LENGTH = 0x00000000;
  define symbol ITCM_START = 0x10000000;
  define symbol ITCM_LENGTH = 0x00020000;
  define symbol DTCM_START = 0x30000000;
  define symbol DTCM_LENGTH = 0x00020000;
  define symbol SDRAM_START = 0x68000000;
  define symbol SDRAM_LENGTH = 0x08000000;
  define symbol OSPI0_CS0_START = 0x80000000;
  define symbol OSPI0_CS0_LENGTH = 0x10000000;
  define symbol OSPI0_CS1_START = 0x90000000;
  define symbol OSPI0_CS1_LENGTH = 0x10000000;
  define symbol OSPI1_CS0_START = 0x70000000;
  define symbol OSPI1_CS0_LENGTH = 0x08000000;
  define symbol OSPI1_CS1_START = 0x78000000;
  define symbol OSPI1_CS1_LENGTH = 0x08000000;
  define symbol OPTION_SETTING_OFS1_START = 0x12c9f4c0;
  define symbol OPTION_SETTING_OFS1_LENGTH = 0x00000004;
  define symbol OPTION_SETTING_OFS3_START = 0x12c9f4c4;
  define symbol OPTION_SETTING_OFS3_LENGTH = 0x00000004;
  define symbol OPTION_SETTING_BPS_START = 0x12c9f600;
  define symbol OPTION_SETTING_BPS_LENGTH = 0x00000080;
  define symbol OPTION_SETTING_OTP_PBPS_START = 0x12e17780;
  define symbol OPTION_SETTING_OTP_PBPS_LENGTH = 0x00000080;
