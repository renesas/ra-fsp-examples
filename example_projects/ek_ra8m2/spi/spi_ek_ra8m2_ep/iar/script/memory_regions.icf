  /* generated memory regions file - do not edit */
  define symbol RAM_START = 0x22000000;
  define symbol RAM_LENGTH = 0x001d4000;
  define symbol FLASH_START = 0x02000000;
  define symbol FLASH_LENGTH = 0x00100000;
  define symbol DATA_FLASH_START = 0x27000000;
  define symbol DATA_FLASH_LENGTH = 0x00000000;
  define symbol SDRAM_START = 0x68000000;
  define symbol SDRAM_LENGTH = 0x08000000;
  define symbol OSPI0_CS0_START = 0x80000000;
  define symbol OSPI0_CS0_LENGTH = 0x10000000;
  define symbol OSPI0_CS1_START = 0x90000000;
  define symbol OSPI0_CS1_LENGTH = 0x10000000;
  define symbol OSPI1_CS0_START = 0x70000000;
  define symbol OSPI1_CS0_LENGTH = 0x08000000;
  define symbol OSPI1_CS1_START = 0x78000000;
  define symbol OSPI1_CS1_LENGTH = 0x08000000;
  define symbol OPTION_SETTING_OFS0_START = 0x02c9f040;
  define symbol OPTION_SETTING_OFS0_LENGTH = 0x00000004;
  define symbol OPTION_SETTING_OFS2_START = 0x02c9f044;
  define symbol OPTION_SETTING_OFS2_LENGTH = 0x00000004;
  define symbol OPTION_SETTING_SAS_START = 0x02c9f074;
  define symbol OPTION_SETTING_SAS_LENGTH = 0x00000004;
  define symbol OPTION_SETTING_OFS1_START = 0x12c9f4c0;
  define symbol OPTION_SETTING_OFS1_LENGTH = 0x00000004;
  define symbol OPTION_SETTING_OFS1_SEC_START = 0x02c9f0c0;
  define symbol OPTION_SETTING_OFS1_SEC_LENGTH = 0x00000004;
  define symbol OPTION_SETTING_OFS1_SEL_START = 0x02c9f120;
  define symbol OPTION_SETTING_OFS1_SEL_LENGTH = 0x00000004;
  define symbol OPTION_SETTING_OFS3_START = 0x12c9f4c4;
  define symbol OPTION_SETTING_OFS3_LENGTH = 0x00000004;
  define symbol OPTION_SETTING_OFS3_SEC_START = 0x02c9f0c4;
  define symbol OPTION_SETTING_OFS3_SEC_LENGTH = 0x00000004;
  define symbol OPTION_SETTING_OFS3_SEL_START = 0x02c9f124;
  define symbol OPTION_SETTING_OFS3_SEL_LENGTH = 0x00000004;
  define symbol OPTION_SETTING_BPS_START = 0x12c9f600;
  define symbol OPTION_SETTING_BPS_LENGTH = 0x00000080;
  define symbol OPTION_SETTING_BPS_SEC_START = 0x02c9f200;
  define symbol OPTION_SETTING_BPS_SEC_LENGTH = 0x00000080;
  define symbol OPTION_SETTING_OTP_FSBLCTRL0_START = 0x02e07600;
  define symbol OPTION_SETTING_OTP_FSBLCTRL0_LENGTH = 0x00000004;
  define symbol OPTION_SETTING_OTP_FSBLCTRL1_START = 0x02e07604;
  define symbol OPTION_SETTING_OTP_FSBLCTRL1_LENGTH = 0x00000004;
  define symbol OPTION_SETTING_OTP_FSBLCTRL2_START = 0x02e07608;
  define symbol OPTION_SETTING_OTP_FSBLCTRL2_LENGTH = 0x00000004;
  define symbol OPTION_SETTING_OTP_SAMR_START = 0x02e07614;
  define symbol OPTION_SETTING_OTP_SAMR_LENGTH = 0x00000004;
  define symbol OPTION_SETTING_OTP_SACC00_START = 0x02e07620;
  define symbol OPTION_SETTING_OTP_SACC00_LENGTH = 0x00000004;
  define symbol OPTION_SETTING_OTP_SACC10_START = 0x02e07630;
  define symbol OPTION_SETTING_OTP_SACC10_LENGTH = 0x00000004;
  define symbol OPTION_SETTING_OTP_SACC01_START = 0x02e07640;
  define symbol OPTION_SETTING_OTP_SACC01_LENGTH = 0x00000004;
  define symbol OPTION_SETTING_OTP_SACC11_START = 0x02e07650;
  define symbol OPTION_SETTING_OTP_SACC11_LENGTH = 0x00000004;
  define symbol OPTION_SETTING_OTP_SACC02_START = 0x02e07660;
  define symbol OPTION_SETTING_OTP_SACC02_LENGTH = 0x00000004;
  define symbol OPTION_SETTING_OTP_SACC12_START = 0x02e07670;
  define symbol OPTION_SETTING_OTP_SACC12_LENGTH = 0x00000004;
  define symbol OPTION_SETTING_OTP_SACC03_START = 0x02e07680;
  define symbol OPTION_SETTING_OTP_SACC03_LENGTH = 0x00000004;
  define symbol OPTION_SETTING_OTP_SACC13_START = 0x02e07690;
  define symbol OPTION_SETTING_OTP_SACC13_LENGTH = 0x00000004;
  define symbol OPTION_SETTING_OTP_PBPS_SEC_START = 0x02e17700;
  define symbol OPTION_SETTING_OTP_PBPS_SEC_LENGTH = 0x00000080;
  define symbol OPTION_SETTING_OTP_PBPS_START = 0x12e17780;
  define symbol OPTION_SETTING_OTP_PBPS_LENGTH = 0x00000080;
  define symbol OPTION_SETTING_OTP_ZHUK_START = 0x02e17920;
  define symbol OPTION_SETTING_OTP_ZHUK_LENGTH = 0x00000004;
  define symbol ITCM_START = 0x00000000;
  define symbol ITCM_LENGTH = 0x00020000;
  define symbol DTCM_START = 0x20000000;
  define symbol DTCM_LENGTH = 0x00020000;
